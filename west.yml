## west.yml
```yaml
manifest:
  version: 1.0

  projects:
    - name: micro-ros
      url: https://github.com/jaypacamarra/micro_ros_zephyr_module
      path: modules/lib/micro-ros
      revision: kilted
    - name: zephyr
      url: https://github.com/zephyrproject-rtos/zephyr
      revision: v4.1.0
      import:
        name-allowlist:
          - cmsis
          - cmsis-dsp
          - cmsis-nn
          - cmsis_6
          - hal_st
          - hal_stm32
          - hal_mxp
          - mcuboot

  self:
    path: microros-zephyr
```
